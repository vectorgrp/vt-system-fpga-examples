/*@!Encoding:65001*/
// Copyright (c) 2024 Vector Informatik GmbH  

// Permission is hereby granted, free of charge, to any person obtaining  
// a copy of this software and associated documentation files (the  
// "Software"), to deal in the Software without restriction, including  
// without limitation the rights to use, copy, modify, merge, publish,  
// distribute, sublicense, and/or sell copies of the Software, and to  
// permit persons to whom the Software is furnished to do so, subject to  
// the following conditions:  
   
// The above copyright notice and this permission notice shall be  
// included in all copies or substantial portions of the Software.  
   
// THE SOFTWARE IS PROVIDED "AS IS", WITHOUT WARRANTY OF ANY KIND,  
// EXPRESS OR IMPLIED, INCLUDING BUT NOT LIMITED TO THE WARRANTIES OF  
// MERCHANTABILITY, FITNESS FOR A PARTICULAR PURPOSE AND  
// NONINFRINGEMENT. IN NO EVENT SHALL THE AUTHORS OR COPYRIGHT HOLDERS BE  
// LIABLE FOR ANY CLAIM, DAMAGES OR OTHER LIABILITY, WHETHER IN AN ACTION  
// OF CONTRACT, TORT OR OTHERWISE, ARISING FROM, OUT OF OR IN CONNECTION  
// WITH THE SOFTWARE OR THE USE OR OTHER DEALINGS IN THE SOFTWARE.


includes
{
}

variables
{ 
}


on start 
{  
  // activate frequency & duty cycle measurment
  @sysvar::VTS::VT5838_1_AIn_Ch1::ActiveFreqDC = 1;
  @sysvar::VTS::VT5838_1_AIn_Ch2::ActiveFreqDC = 1;
  @sysvar::VTS::VT5838_1_AIn_Ch3::ActiveFreqDC = 1;
  @sysvar::VTS::VT5838_1_AIn_Ch4::ActiveFreqDC = 1;
  @sysvar::VTS::VT5838_1_AIn_Ch5::ActiveFreqDC = 1;
  @sysvar::VTS::VT5838_1_AIn_Ch6::ActiveFreqDC = 1;
  @sysvar::VTS::VT5838_1_AIn_Ch7::ActiveFreqDC = 1;
  @sysvar::VTS::VT5838_1_AIn_Ch8::ActiveFreqDC = 1;
  // trigger level [V]
  @sysvar::VTS::VT5838_1::TriggerLevel1And2 = 0.5;
  @sysvar::VTS::VT5838_1::TriggerLevel3And4 = 0.5;
  @sysvar::VTS::VT5838_1::TriggerLevel5And6 = 0.5;
  @sysvar::VTS::VT5838_1::TriggerLevel7And8 = 0.5;
  @sysvar::VTS::VT5838_1::TriggerLevel9And10 = 0.5;
  @sysvar::VTS::VT5838_1::TriggerLevel11And12 = 0.5;
  @sysvar::VTS::VT5838_1::TriggerLevel13And14 = 0.5;
  @sysvar::VTS::VT5838_1::TriggerLevel15And16 = 0.5;
}
