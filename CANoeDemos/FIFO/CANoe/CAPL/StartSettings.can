/*@!Encoding:65001*/
// Copyright (c) 2025 Vector Informatik GmbH  

// Permission is hereby granted, free of charge, to any person obtaining  
// a copy of this software and associated documentation files (the  
// "Software"), to deal in the Software without restriction, including  
// without limitation the rights to use, copy, modify, merge, publish,  
// distribute, sublicense, and/or sell copies of the Software, and to  
// permit persons to whom the Software is furnished to do so, subject to  
// the following conditions:  
   
// The above copyright notice and this permission notice shall be  
// included in all copies or substantial portions of the Software.  
   
// THE SOFTWARE IS PROVIDED "AS IS", WITHOUT WARRANTY OF ANY KIND,  
// EXPRESS OR IMPLIED, INCLUDING BUT NOT LIMITED TO THE WARRANTIES OF  
// MERCHANTABILITY, FITNESS FOR A PARTICULAR PURPOSE AND  
// NONINFRINGEMENT. IN NO EVENT SHALL THE AUTHORS OR COPYRIGHT HOLDERS BE  
// LIABLE FOR ANY CLAIM, DAMAGES OR OTHER LIABILITY, WHETHER IN AN ACTION  
// OF CONTRACT, TORT OR OTHERWISE, ARISING FROM, OUT OF OR IN CONNECTION  
// WITH THE SOFTWARE OR THE USE OR OTHER DEALINGS IN THE SOFTWARE.  

includes
{
}

variables
{ 
}


on start
{
  // output settings
  // channel 13
  sysvar::VTS::VT2816_1_Ch13.SetOutputRange(eVTSOutputRangePlusMinus10V);
  sysvar::VTS::VT2816_1_Ch13.SetStimulationMode(eVTSStimulationModeVoltage);
  sysvar::VTS::VT2816_1_Ch13.SetCurveType(eVTSCurveTypeUserFPGA);
  // channel 14
  sysvar::VTS::VT2816_1_Ch14.SetOutputRange(eVTSOutputRangePlusMinus10V);
  sysvar::VTS::VT2816_1_Ch14.SetStimulationMode(eVTSStimulationModeVoltage);
  sysvar::VTS::VT2816_1_Ch14.SetCurveType(eVTSCurveTypeUserFPGA);
  // channel 15
  sysvar::VTS::VT2816_1_Ch15.SetOutputRange(eVTSOutputRangePlusMinus10V);
  sysvar::VTS::VT2816_1_Ch15.SetStimulationMode(eVTSStimulationModeVoltage);
  sysvar::VTS::VT2816_1_Ch15.SetCurveType(eVTSCurveTypeUserFPGA);
  // channel 16
  sysvar::VTS::VT2816_1_Ch16.SetOutputRange(eVTSOutputRangePlusMinus10V);
  sysvar::VTS::VT2816_1_Ch16.SetStimulationMode(eVTSStimulationModeVoltage);
  sysvar::VTS::VT2816_1_Ch16.SetCurveType(eVTSCurveTypeUserFPGA);
}

