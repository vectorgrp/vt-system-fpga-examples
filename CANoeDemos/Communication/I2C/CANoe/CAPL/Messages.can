/*@!Encoding:65001*/
includes
{
}

variables
{ 
}



// write command

// sensor 1
on sysvar sysvarMember::MasterI2C::WriteMessage_1.Trigger
{
  if(@this)
  {
    @sysvarMember::SENSOR::I2C::Master::Slave1::Write_Stim.TxTrigger = @this;
    @sysvarMember::SENSOR::I2C::Master::Slave1::Write_Stim.WriteSequence.RegisterAddress = @sysvarMember::MasterI2C::WriteMessage_1.Address;
    @sysvarMember::SENSOR::I2C::Master::Slave1::Write_Stim.WriteSequence.Data = @sysvarMember::MasterI2C::WriteMessage_1.Data;
  }
}

// sensor 2
on sysvar sysvarMember::MasterI2C::WriteMessage_2.Trigger
{
  if(@this)
  {
    @sysvarMember::SENSOR::I2C::Master::Slave2::Write_Stim.TxTrigger = @this;
    @sysvarMember::SENSOR::I2C::Master::Slave2::Write_Stim.WriteSequence.RegisterAddress = @sysvarMember::MasterI2C::WriteMessage_2.Address;
    @sysvarMember::SENSOR::I2C::Master::Slave2::Write_Stim.WriteSequence.Data = @sysvarMember::MasterI2C::WriteMessage_2.Data;
  }
}

// sensor 3
on sysvar sysvarMember::MasterI2C::WriteMessage_3.Trigger
{
  if(@this)
  {
    @sysvarMember::SENSOR::I2C::Master::Slave3::Write_Stim.TxTrigger = @this;
    @sysvarMember::SENSOR::I2C::Master::Slave3::Write_Stim.WriteSequence.RegisterAddress = @sysvarMember::MasterI2C::WriteMessage_3.Address;
    @sysvarMember::SENSOR::I2C::Master::Slave3::Write_Stim.WriteSequence.Data = @sysvarMember::MasterI2C::WriteMessage_3.Data;
  }
}

// sensor 4
on sysvar sysvarMember::MasterI2C::WriteMessage_4.Trigger
{
  if(@this)
  {
    @sysvarMember::SENSOR::I2C::Master::Slave4::Write_Stim.TxTrigger = @this;
    @sysvarMember::SENSOR::I2C::Master::Slave4::Write_Stim.WriteSequence.RegisterAddress = @sysvarMember::MasterI2C::WriteMessage_4.Address;
    @sysvarMember::SENSOR::I2C::Master::Slave4::Write_Stim.WriteSequence.Data = @sysvarMember::MasterI2C::WriteMessage_4.Data;
  }
}

// sensor 5
on sysvar sysvarMember::MasterI2C::WriteMessage_5.Trigger
{
  if(@this)
  {
    @sysvarMember::SENSOR::I2C::Master::Slave5::Write_Stim.TxTrigger = @this;
    @sysvarMember::SENSOR::I2C::Master::Slave5::Write_Stim.WriteSequence.RegisterAddress = @sysvarMember::MasterI2C::WriteMessage_5.Address;
    @sysvarMember::SENSOR::I2C::Master::Slave5::Write_Stim.WriteSequence.Data = @sysvarMember::MasterI2C::WriteMessage_5.Data;
  }
}

// read command

// sensor 1
on sysvar sysvarMember::MasterI2C::ReadMessage_1.Trigger
{
  if(@this)
  {
    @sysvarMember::SENSOR::I2C::Master::Slave1::Read_Stim.TxTrigger = @this;
    @sysvarMember::SENSOR::I2C::Master::Slave1::Read_Stim.WriteSequence.RegisterAddress = @sysvarMember::MasterI2C::ReadMessage_1.Address;
  }
}

// sensor 2
on sysvar sysvarMember::MasterI2C::ReadMessage_2.Trigger
{
  if(@this)
  {
    @sysvarMember::SENSOR::I2C::Master::Slave2::Read_Stim.TxTrigger = @this;
    @sysvarMember::SENSOR::I2C::Master::Slave2::Read_Stim.WriteSequence.RegisterAddress = @sysvarMember::MasterI2C::ReadMessage_2.Address;
  }
}

// sensor 3
on sysvar sysvarMember::MasterI2C::ReadMessage_3.Trigger
{
  if(@this)
  {
    @sysvarMember::SENSOR::I2C::Master::Slave3::Read_Stim.TxTrigger = @this;
    @sysvarMember::SENSOR::I2C::Master::Slave3::Read_Stim.WriteSequence.RegisterAddress = @sysvarMember::MasterI2C::ReadMessage_3.Address;
  }
}

// sensor 4
on sysvar sysvarMember::MasterI2C::ReadMessage_4.Trigger
{
  if(@this)
  {
    @sysvarMember::SENSOR::I2C::Master::Slave4::Read_Stim.TxTrigger = @this;
    @sysvarMember::SENSOR::I2C::Master::Slave4::Read_Stim.WriteSequence.RegisterAddress = @sysvarMember::MasterI2C::ReadMessage_4.Address;
  }
}

// sensor 5
on sysvar sysvarMember::MasterI2C::ReadMessage_5.Trigger
{
  if(@this)
  {
    @sysvarMember::SENSOR::I2C::Master::Slave5::Read_Stim.TxTrigger = @this;
    @sysvarMember::SENSOR::I2C::Master::Slave5::Read_Stim.WriteSequence.RegisterAddress = @sysvarMember::MasterI2C::ReadMessage_5.Address;
  }
}